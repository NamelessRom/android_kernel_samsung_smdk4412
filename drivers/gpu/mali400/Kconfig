## drivers/gpu/mali400/Kconfig
```kconfig
menuconfig MALI400
	tristate "Mali-300/400/450 support"
	default y
	depends on ARM
	select DMA_SHARED_BUFFER
	---help---
	  This enables support for the ARM Mali-300, Mali-400, and Mali-450
	  GPUs.

	  To compile this driver as a module, choose M here: the module will be
	  called mali.

choice
depends on MALI400
prompt "Select MALI VER"
default MALI_VER_R4P0
config MALI_VER_R4P0
	bool "Mali400 Version R4P0"
	help
	  Choose this option to select DDK version.

if MALI_VER_R4P0
source "drivers/gpu/mali400/r4p0/mali/Kconfig"
source "drivers/gpu/mali400/r4p0/ump/Kconfig"
endif

endchoice
```

## drivers/net/wireless/btlock/Kconfig
```kconfig
config BCM4334
	tristate "Bluetooth Lock driver"
	default n
	help
	  say M to compile it as module.
```
